/*
 * IRrecord: record and play back IR signals as a minimal 
 * An IR detector/demodulator must be connected to the input RECV_PIN.
 * An IR LED must be connected to the output PWM pin 3.
 * A button must be connected to the input BUTTON_PIN; this is the
 * send button.
 * A visible LED can be connected to STATUS_PIN to provide status.
 *
 * The logic is:
 * If the button is pressed, send the IR code.
 * If an IR code is received, record it.
 *
 * Version 0.11 September, 2009
 * Copyright 2009 Ken Shirriff
 * http://arcfn.com
 */
 

 // Power ON/OFF
unsigned int S_pwr[68]={4600,4350,700,1550,650,1550,650,1600,650,450,650,450,650,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1550,650};

// channel 1 
unsigned int S_1[68]={4650,4300,700,1550,700,1550,650,1550,700,400,700,400,700,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1550,650};

// channel 2
unsigned int S_2[68]={4600,4350,650,1550,700,1500,700,1550,700,400,700,400,700,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1550,650};

// channel 3
unsigned int S_3[68]={4600,4350,700,1500,700,1550,650,1600,650,400,700,450,700,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1500,700};

// channel 4
unsigned int S_4[68]={4600,4350,650,1550,700,1500,700,1550,700,400,700,400,700,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1550,650};

// channel 5
unsigned int S_5[68]={4650,4350,700,1500,700,1550,650,1550,700,400,700,450,700,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1550,700};

// channel 6
unsigned int S_6[68]={4600,4350,650,1550,700,1500,700,1550,700,400,700,400,700,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1550,650};
 
// channel 7
unsigned int S_7[68]={4600,4350,700,1500,700,1550,650,1550,700,400,700,450,700,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1550,700};
 
// channel 8
unsigned int S_8[68]={4600,4350,650,1600,650,1500,700,1550,700,400,700,400,700,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1550,650};
 
// channel 9
unsigned int S_9[68]={4600,4350,700,1500,700,1550,650,1550,700,400,700,450,650,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1550,700};
 
// channel 0
unsigned int S_0[68]={4650,4300,700,1550,700,1500,700,1550,700,400,700,400,700,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1500,700};
 
// source
unsigned int S_scr[68]={4600,4350,700,1550,650,1550,700,1500,700,450,650,450,700,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1500,700};
 
// channel up
unsigned int S_pup[68]={4600,4350,700,1500,700,1500,700,1550,700,450,650,400,700,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1550,650};
 
// channel down
unsigned int S_pdown[68]={4650,4300,700,1550,700,1500,700,1550,700,400,700,400,700,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1500,700};
 
// volume up
unsigned int S_vup[68]={4600,4350,650,1550,700,1500,700,1550,700,400,700,400,700,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1550,650};

// volume down
unsigned int S_vdown[68]={4600,4350,700,1550,650,1550,700,1500,700,450,650,450,700,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1500,700};

// TV/DTV
unsigned int S_tv[68]={4600,4350,650,1550,700,1500,700,1550,700,400,700,400,700,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1500,700};
 
// guide
unsigned int S_guide[68]={4600,4350,700,1500,700,1550,700,1500,700,450,650,450,700,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1500,700};

// exit
unsigned int S_exit[68]={4650,4300,700,1550,650,1550,700,1550,700,400,700,400,700,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1500,700};
 
// mute
unsigned int S_mute[68]={4650,4350,650,1550,650,1550,700,1550,700,400,700,400,700,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1500,700};



#include <IRremote.h>
#include <XBee.h>
#include "ApioXBee.h"

IRsend irsend;

decode_results results;
int buttonState = 0;
int pin = 13;
int repeatNumber=1;

void setup()
{
  apioSetupUno();
  pinMode(pin, OUTPUT);
}

// Storage for the recorded code
unsigned int* codeValue; // The code value if not raw
int codeLen=12; // The length of the code
int toggle = 0; // The RC5/6 toggle state


void sendCode(int repeat) {
    for (int i = 0; i < 3; i++) {
        //irsend.sendSony(0xa90, 12); // Sony TV power code
        irsend.sendRaw(S_pwr,68,38);
        delay(40);
      }
}

int lastButtonState;
int statoVolume=0;
void loop() {
  
  apioReceive();
  if (proprieta!="")
  {
    buttonState=1;
  }
  // If button pressed, send the code. 
  if(proprieta=="onoff")
  {
    codeValue=S_pwr;
  }
  if(proprieta=="uno")
  {
    codeValue=S_1;
  }
  if(proprieta=="due")
  {
    codeValue=S_2;
  }
  if(proprieta=="tre")
  {
    codeValue=S_3;
  }
  if(proprieta=="quattro")
  {
    codeValue=S_4;
  }
  if(proprieta=="cinque")
  {
    codeValue=S_5;
  }
  if(proprieta=="sei")
  {
    codeValue=S_6;
  }
  if(proprieta=="sette")
  {
    codeValue=S_7;
  }
  if(proprieta=="otto")
  {
    codeValue=S_8;
  }
  if(proprieta=="nove")
  {
    codeValue=S_9;
  }
  if(proprieta=="zero")
  {
    codeValue=S_0;
  }
  if(proprieta=="source")
  {
    codeValue=S_scr;
  }
  if(proprieta=="chup")
  {
    codeValue=S_pup;
  }
  if(proprieta=="chdown")
  {
    codeValue=S_pdown;
  }
  if(proprieta=="volup")
  {
    codeValue=S_vup;
  }
  if(proprieta=="voldown")
  {
    codeValue=S_vdown;
  }
  if(proprieta=="tv")
  {
    codeValue=S_tv;
  }
  if(proprieta=="guide")
  {
    codeValue=S_guide;
  }
  if(proprieta=="exit")
  {
    codeValue=S_exit;
  }
  if(proprieta=="mute")
  {
    codeValue=S_mute;
  }
  if(proprieta=="volume")
  {
    int intervallo=valore.toInt()-statoVolume;
    statoVolume=valore.toInt();
    if(intervallo>0)
    {
     repeatNumber=intervallo;
     //codeValue=1040; 
    }
    else
    {
      repeatNumber=-intervallo;
      //codeValue=1041;
    }
  }  
  if (buttonState) {
    Serial.println("Pressed, sending");
    for(int i=0; i<repeatNumber; i++)
    {
/*      if(!lastButtonState)
      {
        buttonState=1;
      }*/
      digitalWrite(pin, HIGH);
      sendCode(lastButtonState != buttonState);
      delay(100); // Wait a bit between retransmissions
      lastButtonState = buttonState;
      delay(100);
      buttonState=LOW;
      digitalWrite(pin, LOW);
    }
    proprieta="";
    dispositivo="";
    repeatNumber=1;
  } 

}
